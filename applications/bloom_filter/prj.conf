## CMakeLists.txt
```
cmake_minimum_required(VERSION 3.20.0)

find_package(Zephyr REQUIRED HINTS $ENV{ZEPHYR_BASE})
project(boom_filter)

target_compile_definitions(app PRIVATE TARGET_HOST=1)

file(GLOB SRC_FILES "${CMAKE_CURRENT_SOURCE_DIR}/../common/*.c")

target_include_directories(app PRIVATE ../common)
target_sources(app PRIVATE ${SRC_FILES} src/bloom-filter.c src/tinybloom.c src/tinybloom.h src/main.c)
```

## prj.conf
```kconfig
CONFIG_HEAP_MEM_POOL_SIZE=65536
CONFIG_DYNAMIC_THREAD=y
CONFIG_DYNAMIC_THREAD_ALLOC=y
```

## src/main.c
```c
/*
 * Copyright (c) 2012-2014 Wind River Systems, Inc.
 *
 * SPDX-License-Identifier: Apache-2.0
 */

#include <stdio.h>
#include <zephyr/kernel.h>

#define STACKSIZE 1024
#define PRIORITY 7

int bloom_filter_main(void);

void thread1(void)
{
	// while (1) {
	// 	printf("Hello from thread1\n");
	// 	k_msleep(2000);
	// }

    bloom_filter_main();
}

void thread2(void)
{
	while (1) {
		// printf("Hello from thread2\n");
		k_msleep(1000);
	}
}

K_THREAD_DEFINE(thread1_id, STACKSIZE, thread1, NULL, NULL, NULL,
		PRIORITY, 0, 0);
K_THREAD_DEFINE(thread2_id, STACKSIZE, thread2, NULL, NULL, NULL,
		PRIORITY, 0, 0);
```

## src/bloom-filter.c
```c
#include "libmin.h"
#include "tinybloom.h"

#define NUM_ITEMS 16
#define NUM_BUCKETS NUM_ITEMS * 4

int bad_search(const unsigned int *array, unsigned int target, size_t size)
{
	int i;
	for (i = 0; i < size; i++)
		if (array[i] == target)
			return 1;

	return 0;
}

int bloom_filter_main(void)
{
	unsigned false_positives = 0, true_positives = 0;
	unsigned false_negatives = 0, true_negatives = 0;

	// unsigned *filter_contents = libmin_malloc(sizeof(unsigned) * NUM_ITEMS);
	// unsigned *test_array = libmin_malloc(sizeof(unsigned) * NUM_ITEMS);

	unsigned filter_contents[NUM_ITEMS];
	unsigned test_array[NUM_ITEMS];

	// Create a bloom filter with (2 << 13) buckets
	bloom_filter *bFilter = create_bfilter(NUM_BUCKETS);

	libmin_printf("Using %lu kilobytes for filter.\n\n", (bFilter->filter_size * sizeof(unsigned)) / 1024);

	libmin_srand(42);

	int i;
	for (i = 0; i < NUM_ITEMS; i++)
	{
		filter_contents[i] = libmin_rand();
		bfilter_add(bFilter, &filter_contents[i]);

		// Fill our test array with a 50/50 mix of numbers that have been entered into the filter, and random numbers
		if (libmin_rand() & 1)
			test_array[i] = filter_contents[i];
		else
			test_array[i] = libmin_rand();
	}

	for (i = 0; i < NUM_ITEMS; i++)
	{
		int filter_present = 0;
		int array_present = 0;

		filter_present = bfilter_check(bFilter, &test_array[i]);

		array_present = bad_search(filter_contents, test_array[i], NUM_ITEMS);

		if (array_present && filter_present)
			true_positives++;
		else if (!array_present && !filter_present)
			true_negatives++;
		else if (!array_present && filter_present)
			false_positives++;
		else if (array_present && !filter_present)
			false_negatives++;
	}

	libmin_printf("True positives: %i\n"
				  "True negatives: %i\n"
				  "False positives: %i\n"
				  "False negatives: %i\n",
				  true_positives, true_negatives, false_positives, false_negatives);

	float success_rate = ((100.0f / NUM_ITEMS) * (true_positives + true_negatives));
	libmin_printf("\n%3.2f%% success rate\n\n", success_rate);

	if (success_rate < 80.0f)
		libmin_printf("WARNING: Success rate less than 80%%.\n\n");

	if (false_negatives)
		libmin_printf("**ERROR:** Test FAILED.\n");
	else
		libmin_printf("Test PASSED.\n");

	// libmin_free(test_array);
	// libmin_free(filter_contents);
	// destroy_bfilter(bFilter);

	libmin_success();
	return 0;
}
```

## src/tinybloom.c
```c
/* Copyright (C) 2010 by Joseph Kogut

This software is licensed under the MIT license.

Permission is hereby granted, free of charge, to any person obtaining a copy
of this software and associated documentation files (the "Software"), to deal
in the Software without restriction, including without limitation the rights
to use, copy, modify, merge, publish, distribute, sublicense, and/or sell
copies of the Software, and to permit persons to whom the Software is
furnished to do so, subject to the following conditions:

The above copyright notice and this permission notice shall be included in
all copies or substantial portions of the Software.

THE SOFTWARE IS PROVIDED "AS IS", WITHOUT WARRANTY OF ANY KIND, EXPRESS OR
IMPLIED, INCLUDING BUT NOT LIMITED TO THE WARRANTIES OF MERCHANTABILITY,
FITNESS FOR A PARTICULAR PURPOSE AND NONINFRINGEMENT. IN NO EVENT SHALL THE
AUTHORS OR COPYRIGHT HOLDERS BE LIABLE FOR ANY CLAIM, DAMAGES OR OTHER
LIABILITY, WHETHER IN AN ACTION OF CONTRACT, TORT OR OTHERWISE, ARISING FROM,
OUT OF OR IN CONNECTION WITH THE SOFTWARE OR THE USE OR OTHER DEALINGS IN
THE SOFTWARE.	*/

#include "libmin.h"
#include "tinybloom.h"

#define GETBIT(a, n) ((a[n >> 5] & (1 << (n & 31))) > 0)
#define SETBIT(a, n) (a[n >> 5] |= 1 << (n & 31))

bloom_filter* create_bfilter(size_t size)
{
	bloom_filter* bFilter;
	bFilter = (bloom_filter*)malloc(sizeof(bloom_filter));

	bFilter->filter_size = (size / (sizeof(unsigned) * 8)) + ((size % sizeof(unsigned) * 8) != 0 ? 1 : 0);

	bFilter->num_buckets = (bFilter->filter_size) * sizeof(unsigned) * 8;

	bFilter->filter = (unsigned*)malloc((bFilter->filter_size) * sizeof(unsigned));
	libmin_memset(bFilter->filter, 0, bFilter->filter_size);

	return bFilter;
}

void destroy_bfilter(bloom_filter* bFilter)
{
	if(bFilter->filter) libmin_free(bFilter->filter);
	if(bFilter) libmin_free(bFilter);

	bFilter->filter = NULL;
	bFilter = NULL;
}

void bfilter_add(const bloom_filter* bFilter, const unsigned* input)
{
	SETBIT(bFilter->filter, *input % bFilter->num_buckets);
}


int bfilter_check(const bloom_filter* bFilter, const unsigned* input)
{
	return GETBIT(bFilter->filter, *input % bFilter->num_buckets);
}

int bfilter_intersect(bloom_filter* a, bloom_filter* b)
{
	if(a->filter_size != b->filter_size) return 1;

	int i;
	for(i = 0; i < a->filter_size; i++)
		a->filter[i] |= b->filter[i];

	return 0;
}
```
