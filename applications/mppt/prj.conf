## CMakeLists.txt
```
# SPDX-License-Identifier: Apache-2.0

cmake_minimum_required(VERSION 3.20.0)

find_package(Zephyr REQUIRED HINTS $ENV{ZEPHYR_BASE})
project(mppt)

target_sources(app PRIVATE src/main.c src/mppt/mppt.c src/mppt/mppt.h)
```

## prj.conf
```kconfig
CONFIG_SERIAL=y
CONFIG_UART_NATIVE_TTY=y
```

## src/main.c
```c
/*
 * Copyright (c) 2012-2014 Wind River Systems, Inc.
 *
 * SPDX-License-Identifier: Apache-2.0
 */

#include <stdio.h>
#include <zephyr/kernel.h>
#include "mppt/mppt.h"

#define STACKSIZE 1024
#define PRIORITY 7

void thread1(void)
{
	while (1) {
		// printf("Hello from thread1\n");
		mppt();
		k_msleep(2000);
	}
}

void thread2(void)
{
	while (1) {
		// printf("Hello from thread2\n");
		k_msleep(1000);
	}
}

K_THREAD_DEFINE(thread1_id, STACKSIZE, thread1, NULL, NULL, NULL,
		PRIORITY, 0, 0);
K_THREAD_DEFINE(thread2_id, STACKSIZE, thread2, NULL, NULL, NULL,
		PRIORITY, 0, 0);
```
